## config/boards/shields/dongle83/Kconfig.shield
```kconfig
# Copyright (c) 2020 The ZMK Contributors
# SPDX-License-Identifier: MIT

config SHIELD_DONGLE83
	def_bool $(shields_list_contains,dongle83)

config SHIELD_DONGLE83_DONGLE
	def_bool $(shields_list_contains,dongle83_dongle)
```
